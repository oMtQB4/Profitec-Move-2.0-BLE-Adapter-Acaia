## main/Kconfig.projbuild
```kconfig
menu "Acaia Bridge"

    config BRIDGE_NAME_PREFIX
        string "Advertised name prefix"
        default "LUNAR-"
        help
            The emulated scale advertises as this prefix plus the last three
            bytes of the Bluetooth MAC. Acaia clients match on "LUNAR".

    config BRIDGE_ADVERTISE_WITHOUT_SCALE
        bool "Advertise even when no real scale is connected"
        default n
        help
            Useful to test the Acaia side with the coffee machine before a
            real scale is available. Otherwise the emulated scale is only
            visible while a real scale is connected.

    choice BRIDGE_AUTO_TARE_DEFAULT
        prompt "Auto-tare (default, changeable in the configurator)"
        default BRIDGE_AUTO_TARE_CUP
        help
            The Profitec Move 2.0 connects only a few seconds after the shot has
            started and sends no tare command, so the adapter zeroes the weight
            by itself. These are the defaults until the Bluetooth configurator
            changes them (stored in NVS).

        config BRIDGE_AUTO_TARE_CUP
            bool "When a cup is put down, else when the machine connects"
            help
                Like a Lunar in its espresso modes: tare as soon as a cup is put
                down (at least 20 g, placed within 2 s, then steady) or taken
                off while the machine is not connected. Slow changes such as
                pouring don't trigger it. When the machine connects with an
                untared cup on the scale, the weight is zeroed then.

        config BRIDGE_AUTO_TARE_CONNECT
            bool "When the machine connects"
            help
                Zero the weight the moment the coffee machine connects, a few
                seconds into the shot. Other devices (apps, the configurator)
                don't trigger it once the machine's address is learned.

        config BRIDGE_AUTO_TARE_OFF
            bool "Off"
    endchoice

    config BRIDGE_TARE_SCALE
        bool "Also tare the real scale (default, changeable in the configurator)"
        default y
        help
            The adapter zeroes the weight the machine sees instantly with a
            software offset. With this option it also sends a tare command to
            the real scale, so its display shows 0 too. Without it the real
            scale keeps its own zero.

    config BRIDGE_STATUS_LED
        bool "Show status on an addressable RGB LED (WS2812)"
        default y
        help
            Red blinking: searching for the scale. Yellow: scale connected,
            waiting for the coffee machine. Blue: machine connected. Green:
            another device connected. The configurator can limit the LED to
            connections or switch it off.

    config BRIDGE_STATUS_LED_GPIO
        int "Status LED GPIO"
        depends on BRIDGE_STATUS_LED
        range 0 48
        default 48
        help
            ESP32-S3-DevKitC-1 v1.0 uses GPIO48, v1.1 uses GPIO38.

    config BRIDGE_STATUS_LED_BRIGHTNESS
        int "Status LED brightness (1-255, default, changeable in the configurator)"
        depends on BRIDGE_STATUS_LED
        range 1 255
        default 24

    config BRIDGE_LOG_SCAN_RESULTS
        bool "Log every BLE device seen while scanning for scales"
        default n
        help
            Logs name, address, RSSI and whether a driver matched. Useful to
            find the advertised name of a scale that should get a driver.

    config BRIDGE_LOG_ACAIA_FRAMES
        bool "Hex-log Acaia frames exchanged with the coffee machine"
        default y
        help
            Logs every write from the machine and every non-weight frame
            sent back. Weight notifications are not logged.

    menu "Firmware update over Bluetooth"

        config BRIDGE_UPDATE_BUTTON
            bool "Enter update mode by holding a button for 3 s"
            default y
            help
                Holding the button for 3 s while the bridge runs restarts the
                adapter in update mode (status LED purple). Holding it again
                in update mode returns to the bridge.

        config BRIDGE_UPDATE_BUTTON_GPIO
            int "Update button GPIO"
            depends on BRIDGE_UPDATE_BUTTON
            range 0 48
            default 0
            help
                GPIO0 is the BOOT button on ESP32-S3 DevKit boards (active low,
                internal pull-up). It only acts as a strapping pin while the
                chip resets, so holding it later is safe.

        config BRIDGE_UPDATE_POWER_CYCLES
            int "Enter update mode after this many short power-ons in a row (0 = off)"
            range 0 10
            default 3
            help
                For adapters in a case without access to the button: power the
                adapter on this many times in a row, each time cutting power
                again within 10 s. The last power-on starts update mode.

        config BRIDGE_UPDATE_MODE_TIMEOUT_MIN
            int "Leave update mode after this many minutes without an update"
            range 1 60
            default 5

    endmenu

endmenu
```
